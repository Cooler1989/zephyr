## boards/arm/seeeduino_wio_terminal/Kconfig.board
```kconfig
# Seeeduino XIAO board configuration

# Copyright (c) 2020 Google LLC.
# SPDX-License-Identifier: Apache-2.0

config BOARD_SEEEDUINO_WIO_TERMINAL
	bool "Seeeduino Wio Terminal"
	depends on SOC_PART_NUMBER_SAMD51P19A
```

## boards/arm/seeeduino_wio_terminal/Kconfig.defconfig
```kconfig
# Seeedunio WIO Terminal board configuration

# Copyright (c) 2020 Google LLC.
# SPDX-License-Identifier: Apache-2.0

config BOARD
	default "seeeduino_wio_terminal"
	depends on BOARD_SEEEDUINO_WIO_TERMINAL
```
